## config/boards/shields/diy_numpad/Kconfig.defconfig
```kconfig
if SHIELD_DIY_NUMPAD

config ZMK_KEYBOARD_NAME
    default "Min Numpad"

config ZMK_USB
    default y

endif
```

## config/west.yml
```yaml
manifest:
  remotes:
    - name: zmkfirmware
      url-base: https://github.com/zmkfirmware
  projects:
    - name: zmk
      remote: zmkfirmware
      revision: zmk-stable
      import: app/west.yml
  self:
    path: config
```
